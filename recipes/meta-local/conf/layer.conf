## recipes/meta-local/conf/layer.conf
```bitbake
# We have a conf and classes directory, add to BBPATH
BBPATH .= ":${LAYERDIR}"

# We have recipes-* directories, add to BBFILES
BBFILES += "${LAYERDIR}/recipes-*/*/*.bb \
            ${LAYERDIR}/recipes-*/*/*.bbappend"

BBFILE_COLLECTIONS += "meta-local"
BBFILE_PATTERN_meta-local = "^${LAYERDIR}/"
BBFILE_PRIORITY_meta-local = "100"

LAYERDEPENDS_meta-local = "core"
LAYERSERIES_COMPAT_meta-local = "kirkstone scarthgap"

BBFILES_DYNAMIC += " \
    core:${LAYERDIR}/dynamic-layers/poky/meta/*/*/*.bb \
    core:${LAYERDIR}/dynamic-layers/poky/meta/*/*/*.bbappend \
    raspberrypi:${LAYERDIR}/dynamic-layers/bsp/meta-raspberrypi/*/*/*.bb \
    raspberrypi:${LAYERDIR}/dynamic-layers/bsp/meta-raspberrypi/*/*/*.bbappend \
    agl-kvm-demo-layer:${LAYERDIR}/dynamic-layers/meta-agl-demo/meta-agl-kvm-demo/*/*/*.bb \
    agl-kvm-demo-layer:${LAYERDIR}/dynamic-layers/meta-agl-demo/meta-agl-kvm-demo/*/*/*.bbappend \
"
```

## recipes/meta-local/dynamic-layers/meta-agl-demo/meta-agl-kvm-demo/recipes-platform/images/wic/sdimage-raspberrypi-usb-boot.wks
```
# short-description: Create Raspberry Pi USB Memory image
# long-description: Creates a partitioned SD card image for use with
# Raspberry Pi, modified for USB boot. Boot files are located in the first vfat partition.

part /boot --source bootimg-partition --ondisk sda --fstype=vfat --label boot --active --align 4096 --size 20
part / --source rootfs --ondisk sda --fstype=ext4 --label root --align 4096
```
